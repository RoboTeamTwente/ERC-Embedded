#include "menu_driver.h"
#include "menu_driver_list.h"
#include "cmsis_os2.h"
#include "FreeRTOS.h"
#include "task.h"
#include "logging.h"
#include "stm32h7xx_nucleo.h"



static const uint8_t main_menu_icons[4][MENU_DRIVER_ICON_BYTE_SIZE] = {
    {0xff, 0xe3, 0xff, 0xff, 0xff, 0xc3, 0xff, 0xff, 0xff, 0xc3, 0xff, 0xff,
     0xff, 0x81, 0xff, 0xff, 0xff, 0x19, 0xff, 0xff, 0xff, 0x39, 0xff, 0xff,
     0xfe, 0x39, 0xff, 0xff, 0xfc, 0x79, 0xff, 0xff, 0xfc, 0xf9, 0xff, 0xff,
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     0xff, 0xc0, 0x03, 0xff, 0xff, 0xe0, 0x07, 0xff}

};

static menu_page_state main_menu_state = {.list = {
                                              .num_entries = 4,
                                              .selected_index = 0,
                                              .entry_ids = {1, 2, 3, 4},
                                              .entry_icons = main_menu_icons,
                                          }};

static menu_page_t pages[10] = {[0] =
                                    {
                                        .name = "Main Menu",
                                        .state = &main_menu_state,
                                        .id = 0,
                                        .needs_render = true,
                                        .render = menu_page_render_list,

                                    },
                                [1] = {.name = "Diagnostics"},
                                [2] = {.name = "Testing"},
                                [3] = {.name = "Logs"},
                                [4] = {.name = "Sensors"}};

static menu_manager_t manager = {
    .active_page_id = 0,
    .pages = &pages,
    .get_input = 0,
};


static const char* TAG = "MENU DRIVER TASK";


#define MENU_DRIVER_STACK_WORDS   (4096u)  /* words, not bytes, for CMSIS */

static uint32_t menu_driver_stack[MENU_DRIVER_STACK_WORDS];
static StaticTask_t menu_driver_tcb;

const osThreadAttr_t menu_driver_task_attr = {
    .name = "menu_driver",
    .stack_size = 1024 * 2,
    .priority = (osPriority_t)osPriorityNormal,
};

osThreadId_t s_menu_driver_task_handle = NULL;

void menu_driver_task(void* arg) {
  menu_manager_init_display();
  menu_driver_draw_ribbon();
  LOGI(TAG, "Rendering Active Page\n");
  LOGI(TAG, "Rendered list");
  int id = manager.active_page_id;
  page_list_state* state = &(manager.pages[id].state->list);
  state->first_render = true;
  while (1) {
    LOGI(TAG, "In loop");
    state->selected_index += 1;
    state->selected_index %= state->num_entries;
    menu_page_render_list(&manager);
    osDelay(1000);
  }
}

result_t menu_driver_task_spawn(menu_manager_t *manager) {
  if (manager == NULL) {
    return RESULT_ERR_INVALID_ARG;
  }

  if (s_menu_driver_task_handle != NULL) {
    return RESULT_ERR_ALREADY_EXISTS;
  }

  s_menu_driver_task_handle = osThreadNew(menu_driver_task, NULL, &menu_driver_task_attr);
  if (s_menu_driver_task_handle == NULL) {
    return RESULT_ERR_NO_MEM; /* or RESULT_ERR / RESULT_OS_FAIL, depending on your enum */
  }

  return RESULT_OK;

}
